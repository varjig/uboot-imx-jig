// SPDX-License-Identifier: GPL-2.0+
/*
 * Copyright 2019 NXP
 * Copyright 2020-2025 Variscite Ltd.
 * Copyright 2026 Variscite Ltd.
 */

#include "imx8mp-var-common-u-boot.dtsi"

&pinctrl_uart2 {
	u-boot,dm-spl;
};

&uart2 {
	u-boot,dm-spl;
};
