// SPDX-License-Identifier: GPL-2.0+
/*
 * Copyright 2019 NXP
 * Copyright 2020-2021 Variscite Ltd.
 */

#include "imx8mp-var-common-u-boot.dtsi"

&uart2 {
	u-boot,dm-spl;
};

&pinctrl_uart2 {
	u-boot,dm-spl;
};

/delete-node/ &pinctrl_reg_usdhc2_vmmc;
/delete-node/ &pinctrl_usdhc2_gpio;
